## firmware/sdkconfig.defaults
```kconfig
# Flash size — Heltec WiFi LoRa 32 V3 has 8 MB flash
CONFIG_ESPTOOLPY_FLASHSIZE_8MB=y
CONFIG_ESPTOOLPY_FLASHSIZE="8MB"

# Bluetooth — NimBLE host + controller (required by ble/ble.c)
CONFIG_BT_ENABLED=y
CONFIG_BT_NIMBLE_ENABLED=y
CONFIG_BT_CONTROLLER_ENABLED=y

# WebSocket client component (MESH_WEB_ENABLED builds only)
CONFIG_ESP_WEBSOCKET_CLIENT=y

# TLS — needed if the server is wss:// (Azure Web App uses HTTPS by default)
CONFIG_ESP_TLS=y
CONFIG_ESP_TLS_USING_MBEDTLS=y
CONFIG_MBEDTLS_CERTIFICATE_BUNDLE=y
CONFIG_MBEDTLS_CERTIFICATE_BUNDLE_DEFAULT_FULL=y
```
