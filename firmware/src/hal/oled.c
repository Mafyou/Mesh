#include "hal/oled.h"

#include <string.h>
#include "driver/gpio.h"
#include "driver/i2c_master.h"
#include "esp_check.h"
#include "esp_log.h"
#include "freertos/FreeRTOS.h"
#include "freertos/task.h"

static const char *TAG = "oled";

#define OLED_I2C_PORT        I2C_NUM_0
#define OLED_SDA_GPIO        17
#define OLED_SCL_GPIO        18
#define OLED_I2C_FREQ_HZ     400000
#define OLED_ADDR_DEFAULT    0x3C
#define OLED_ADDR_ALT        0x3D

#define HELTEC_VEXT_GPIO     36
#define HELTEC_OLED_RST_GPIO 21

static i2c_master_bus_handle_t s_bus;
static i2c_master_dev_handle_t s_dev;
static uint8_t                 s_addr;

/* clang-format off */
static const uint8_t s_font5x7[][5] = {
    {0x00, 0x00, 0x00, 0x00, 0x00}, /* ' ' 0x20 */
    {0x00, 0x00, 0x5F, 0x00, 0x00}, /* '!' 0x21 */
    {0x00, 0x07, 0x00, 0x07, 0x00}, /* '"' 0x22 */
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    {0x10, 0x08, 0x08, 0x10, 0x08}, /* '~' 0x7E */
};
/* clang-format on */

static const uint8_t *glyph_for_char(char c)
{
    if ((uint8_t)c < 0x20 || (uint8_t)c > 0x7E) {
        return s_font5x7[0];
    }
    return s_font5x7[(uint8_t)c - 0x20];
}

static void board_power_on(void)
{
    gpio_config_t cfg = {
        .pin_bit_mask = (1ULL << HELTEC_VEXT_GPIO) | (1ULL << HELTEC_OLED_RST_GPIO),
        .mode         = GPIO_MODE_OUTPUT,
        .pull_up_en   = GPIO_PULLUP_DISABLE,
        .pull_down_en = GPIO_PULLDOWN_DISABLE,
        .intr_type    = GPIO_INTR_DISABLE,
    };
    ESP_ERROR_CHECK(gpio_config(&cfg));

    gpio_set_level(HELTEC_VEXT_GPIO, 0);
    gpio_set_level(HELTEC_OLED_RST_GPIO, 0);
    vTaskDelay(pdMS_TO_TICKS(10));
    gpio_set_level(HELTEC_OLED_RST_GPIO, 1);
    vTaskDelay(pdMS_TO_TICKS(50));
}

static esp_err_t write_cmd(uint8_t cmd)
{
    uint8_t buf[2] = {0x00, cmd};
    return i2c_master_transmit(s_dev, buf, sizeof(buf), -1);
}

static esp_err_t write_data(const uint8_t *data, size_t len)
{
    if (len == 0 || len > OLED_WIDTH) {
        return ESP_ERR_INVALID_ARG;
    }
    uint8_t buf[1 + OLED_WIDTH];
    buf[0] = 0x40;
    memcpy(&buf[1], data, len);
    return i2c_master_transmit(s_dev, buf, len + 1, -1);
}

static esp_err_t set_cursor(uint8_t page, uint8_t col)
{
    ESP_RETURN_ON_ERROR(write_cmd((uint8_t)(0xB0 | (page & 0x07))), TAG, "page");
    ESP_RETURN_ON_ERROR(write_cmd((uint8_t)(0x00 | (col & 0x0F))), TAG, "col-lo");
    ESP_RETURN_ON_ERROR(write_cmd((uint8_t)(0x10 | ((col >> 4) & 0x0F))), TAG, "col-hi");
    return ESP_OK;
}

esp_err_t oled_init(void)
{
    board_power_on();

    i2c_master_bus_config_t bus_cfg = {
        .i2c_port              = OLED_I2C_PORT,
        .sda_io_num            = OLED_SDA_GPIO,
        .scl_io_num            = OLED_SCL_GPIO,
        .clk_source            = I2C_CLK_SRC_DEFAULT,
        .glitch_ignore_cnt     = 7,
        .flags.enable_internal_pullup = true,
    };
    ESP_RETURN_ON_ERROR(i2c_new_master_bus(&bus_cfg, &s_bus), TAG, "bus init");

    if (i2c_master_probe(s_bus, OLED_ADDR_DEFAULT, 100) == ESP_OK) {
        s_addr = OLED_ADDR_DEFAULT;
    } else if (i2c_master_probe(s_bus, OLED_ADDR_ALT, 100) == ESP_OK) {
        s_addr = OLED_ADDR_ALT;
    } else {
        ESP_LOGE(TAG, "OLED not found on I2C");
        return ESP_ERR_NOT_FOUND;
    }
    ESP_LOGI(TAG, "OLED at 0x%02X", s_addr);

    i2c_device_config_t dev_cfg = {
        .dev_addr_length = I2C_ADDR_BIT_LEN_7,
        .device_address  = s_addr,
        .scl_speed_hz    = OLED_I2C_FREQ_HZ,
    };
    ESP_RETURN_ON_ERROR(i2c_master_bus_add_device(s_bus, &dev_cfg, &s_dev), TAG, "add dev");

    static const uint8_t init_seq[] = {
        0xAE,             /* display off */
        0x20, 0x02,       /* page addressing mode */
        0x40,             /* start line 0 */
        0xA1,             /* segment remap */
        0xC8,             /* COM output scan direction */
        0x81, 0x7F,       /* contrast */
        0xA6,             /* normal display */
        0xA8, 0x3F,       /* multiplex ratio */
        0xD3, 0x00,       /* display offset */
        0xD5, 0x80,       /* oscillator frequency */
        0xD9, 0xF1,       /* pre-charge period */
        0xDA, 0x12,       /* COM pins */
        0xDB, 0x40,       /* VCOMH deselect */
        0x8D, 0x14,       /* charge pump enable */
        0xAF,             /* display on */
    };
    for (size_t i = 0; i < sizeof(init_seq); i++) {
        ESP_RETURN_ON_ERROR(write_cmd(init_seq[i]), TAG, "init cmd");
    }

    return oled_clear();
}

esp_err_t oled_clear(void)
{
    uint8_t blank[OLED_WIDTH] = {0};
    for (uint8_t page = 0; page < OLED_PAGES; page++) {
        ESP_RETURN_ON_ERROR(set_cursor(page, 0), TAG, "cursor");
        ESP_RETURN_ON_ERROR(write_data(blank, sizeof(blank)), TAG, "clear page");
    }
    return ESP_OK;
}

esp_err_t oled_draw_text(uint8_t page, uint8_t col, const char *text)
{
    if (!text || page >= OLED_PAGES) {
        return ESP_ERR_INVALID_ARG;
    }
    ESP_RETURN_ON_ERROR(set_cursor(page, col), TAG, "cursor");

    const uint8_t spacer = 0x00;
    for (size_t i = 0; text[i] != '\0'; i++) {
        if (col + OLED_CHAR_WIDTH > OLED_WIDTH) {
            break;
        }
        ESP_RETURN_ON_ERROR(write_data(glyph_for_char(text[i]), 5), TAG, "glyph");
        ESP_RETURN_ON_ERROR(write_data(&spacer, 1), TAG, "spacer");
        col += OLED_CHAR_WIDTH;
    }
    return ESP_OK;
}
